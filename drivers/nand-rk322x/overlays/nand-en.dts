/dts-v1/;
/plugin/;
/ {
  fragment@0 {
    target-path = "/nand-controller@30030000";
    __overlay__ {
      status = "okay";
      pinctrl-names = "default";
      pinctrl-0 = < 0xa7 0xab 0xa8 0xa2 0xac 0xaa 0xa6 0xa9 0xad >;
    };
  };
  fragment@1 {
    target-path = "/nand-controller@30030000/nand@0";
    __overlay__ {
      status = "okay";
      nand-ecc-strength = < 0x28 >;
      nand-ecc-step-size = < 0x400 >;
    };
  };
};
